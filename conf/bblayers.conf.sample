## conf/bblayers.conf.sample
```bitbake
# LAYER_CONF_VERSION is increased each time build/conf/bblayers.conf
# changes incompatibly
LCONF_VERSION = "6"

BBPATH = "${TOPDIR}"
BBFILES ?= ""

BBLAYERS ?= " \
  ##OEROOT##/meta \
  ##OEROOT##/meta-yocto \
  ##OEROOT##/meta-yocto-bsp \
  ##OEROOT##/meta-oe/meta-oe \
  ##OEROOT##/meta-oe/meta-networking \
  ##OEROOT##/meta-oe/meta-python \
  ##OEROOT##/meta-oe/meta-gnome \
  ##OEROOT##/meta-securepoint-public/meta-securepoint \
  "
BBLAYERS_NON_REMOVABLE ?= " \
  ##OEROOT##/meta \
  ##OEROOT##/meta-yocto \
  "
```

## meta-securepoint/conf/distro/coughing-karl.conf
```bitbake
# Distribution definition for: Coughing-karl - Securepoint Distro
#
# Copyright (c) 2022, Securepoint GmbH.
# All rights reserved.
#
# This file is released under the MIT license as described in
# ../meta/COPYING.MIT.
#

require conf/distro/poky.conf
DISTRO = "coughing-karl"
DISTRO_NAME = "SP base linux (Coughing Karl)"
DISTRO_VERSION = "0.4"
MAINTAINER = "Securepoint GmbH"

EFI_PROVIDER = "systemd-boot"

POKY_DEFAULT_DISTRO_FEATURES = "largefile"
POKY_DEFAULT_EXTRA_RDEPENDS = "packagegroup-core-boot"

# tomoyo IMAGE FEATURE
FEATURE_PACKAGES_tomoyo = "tomoyo-init"

# Distro config is evaluated after the machine config, so we have to explicitly
# set the kernel provider to override a machine config.
PREFERRED_PROVIDER_virtual/kernel = "linux-yocto"
PREFERRED_VERSION_linux-yocto ??= "5.10%"

# We can use packagegroup-core-boot, but in the future we may need a new packagegroup-core-tiny
#POKY_DEFAULT_EXTRA_RDEPENDS += "packagegroup-core-boot"
# Drop kernel-module-af-packet from RRECOMMENDS
POKY_DEFAULT_EXTRA_RRECOMMENDS = ""

TCLIBC = "glibc"
# FIXME: what should we do with this?
TCLIBCAPPEND = ""

# Disable wide char support for ncurses as we don't include it in
# in the LIBC features below.
#ENABLE_WIDEC="false"

# Drop native language support. This removes the
# eglibc->bash->gettext->libc-posix-clang-wchar dependency.
#USE_NLS="no"

# -dev packages require pkgconfig, but it pulls in glib->dbus->shadow
# which breaks with tiny's minimal libc.
# -dev packages are not currently supported on poky-tiny.
ASSUME_PROVIDED += "pkgconfig$"

# Reconfigure eglibc for a smaller installation
# Comment out any of the lines below to disable them in the build

DISTRO_FEATURES_LIBC_TINY = "libc-libm libc-posix-wchar-io libc-inet libc-spawn libc-posix-clang-wchar libc-nsswitch libc-ftraverse"
DISTRO_FEATURES_LIBC_I18N = "libc-locale-code libc-locales libc-charsets"

# Required for "who/whoami"
DISTRO_FEATURES_LIBC_MINIMAL = "libc-utmp libc-getlogin libc-nis"
DISTRO_FEATURES_LIBC_REGEX = "libc-posix-regexp"
# libc-rcmd is required for shadow-utils
DISTRO_FEATURES_LIBC_NET = "libc-inet libc-rcmd libc-inet-anl"
# libc-crypt-ufc is required for "ppp" (setkey/encrypt)
DISTRO_FEATURES_LIBC_CRYPT = "libc-crypt libc-crypt-ufc"
DISTRO_FEATURES_LIBC_BACKTRACE = "libc-backtrace"
# floating point to string and back, required by perl
DISTRO_FEATURES_LIBC_CVT  = "libc-fcvt"
# required by 'socat'
DISTRO_FEATURES_LIBC_STREAMS  = "libc-streams"

DISTRO_FEATURES_LIBC = "${DISTRO_FEATURES_LIBC_TINY} \
                        ${DISTRO_FEATURES_LIBC_MINIMAL} \
                        ${DISTRO_FEATURES_LIBC_REGEX} \
                        ${DISTRO_FEATURES_LIBC_NET} \
                        ${DISTRO_FEATURES_LIBC_CRYPT} \
                        ${DISTRO_FEATURES_LIBC_BACKTRACE} \
                        ${DISTRO_FEATURES_LIBC_CVT} \
                        ${DISTRO_FEATURES_LIBC_I18N} \
                        ${DISTRO_FEATURES_LIBC_STREAMS} \
                       "

# Comment out any of the lines below to disable them in the build
# DISTRO_FEATURES options:
# alsa bluetooth ext2 irda pcmcia usbgadget usbhost wifi nfs zeroconf pci
DISTRO_FEATURES_TINY = "pci ext2"
DISTRO_FEATURES_NET = "ipv4 ipv6"
DISTRO_FEATURES_USB = "usbhost"
DISTRO_FEATURES_KEYBOARD = "keyboard"
DISTRO_FEATURES_PAM = "pam"
#DISTRO_FEATURES_USBGADGET = "usbgadget"
#DISTRO_FEATURES_WIFI = "wifi"
DISTRO_FEATURES_IPSEC = "ipsec"
DISTRO_FEATURES_SASL = "sasl"

DISTRO_FEATURES = "${DISTRO_FEATURES_TINY} \
                   ${DISTRO_FEATURES_NET} \
                   ${DISTRO_FEATURES_USB} \
                   ${DISTRO_FEATURES_USBGADGET} \
                   ${DISTRO_FEATURES_WIFI} \
                   ${DISTRO_FEATURES_LIBC} \
                   ${DISTRO_FEATURES_KEYBOARD} \
                   ${DISTRO_FEATURES_PAM} \
                   ${DISTRO_FEATURES_IPSEC} \
                   ${DISTRO_FEATURES_SASL} \
                  "

DISTRO_FEATURES_BACKFILL_CONSIDERED += "pulseaudio alsa"

PREFERRED_PROVIDER_jpeg ?= "jpeg"


# Use tmpdevfs and the busybox runtime services
VIRTUAL-RUNTIME_dev_manager = "udev"
VIRTUAL-RUNTIME_login_manager = "busybox"
VIRTUAL-RUNTIME_init_manager = "tiny-init"
VIRTUAL-RUNTIME_keymaps = "keymaps"

# FIXME: Consider adding "modules" to MACHINE_FEATURES and using that in
# packagegroup-core-base to select modutils-initscripts or not.  Similar with "net" and
# netbase.

# By default we only support ext2 and initramfs. We don't build live as that
# pulls in a lot of dependencies for the live image and the installer, like
# udev, grub, etc.  These pull in gettext, which fails to build with wide
# character support.
IMAGE_FSTYPES = "squashfs ext2"

# Drop v86d from qemu dependency list (we support serial)
# Drop grub from meta-intel BSPs
# FIXME: A different mechanism is needed here. We could define -tiny
#        variants of all compatible machines, but that leads to a lot
#        more machine configs to maintain long term.
MACHINE_ESSENTIAL_EXTRA_RDEPENDS = ""

# The mtrace script included by eglibc is a perl script. This means the system
# will build perl in case this package is installed. Since we don't care about
# this script for the purposes of tiny, remove the dependency from here.
RDEPENDS_${PN}-mtrace_pn-glibc = ""

ERROR_QA = "dev-so debug-deps dev-deps debug-files arch pkgconfig la perms \
            useless-rpaths rpaths staticdev ldflags pkgvarcheck already-stripped \
            compile-host-path dep-cmp install-host-path \
            packages-list perm-config perm-line perm-link pkgv-undefined \
            pn-overrides split-strip var-undefined version-going-backwards"

WARN_QA += " installed-vs-shipped"
```

## meta-securepoint/conf/distro/spdocker.conf
```bitbake
# Distribution definition for: docker - Securepoint Distro
#
# Copyright (c) 2021, Securepoint GmbH.
# All rights reserved.
#
# This file is released under the MIT license as described in
# ../meta/COPYING.MIT.
#


require conf/distro/poky.conf
DISTRO = "spdocker"
DISTRO_NAME = "Docker"
DISTRO_VERSION = "0.1"
DISTRO_CODENAME = "inthebox"
MAINTAINER = "Securepoint"


POKY_DEFAULT_DISTRO_FEATURES = "largefile"
POKY_DEFAULT_EXTRA_RDEPENDS = ""
POKY_DEFAULT_EXTRA_RRECOMMENDS = ""

TARGET_VENDOR = "-docker"
PREFERRED_PROVIDER_virtual/kernel = "linux-dummy"
TCLIBC = "glibc"
TCLIBCAPPEND = ""
DISTRO_FEATURES_LIBC_TINY = "libc-libm libc-posix-wchar-io libc-inet libc-spawn libc-posix-clang-wchar libc-nsswitch libc-ftraverse"
DISTRO_FEATURES_LIBC_TINY:append:x86-64 = " libc-libm-big"

#DISTRO_FEATURES_LIBC_I18N = "libc-locale-code libc-locales libc-charsets"

# Required for "who/whoami"
DISTRO_FEATURES_LIBC_MINIMAL = "libc-utmp libc-getlogin libc-nis"
DISTRO_FEATURES_LIBC_REGEX = "libc-posix-regexp"
# libc-rcmd is required for shadow-utils
#DISTRO_FEATURES_LIBC_NET = "libc-inet libc-rcmd libc-inet-anl"
# libc-crypt-ufc is required for "ppp" (setkey/encrypt)
DISTRO_FEATURES_LIBC_CRYPT = "libc-crypt"
#DISTRO_FEATURES_LIBC_BACKTRACE = "libc-backtrace"
# floating point to string and back, required by perl
#DISTRO_FEATURES_LIBC_CVT  = "libc-fcvt"
# required by 'socat'
#DISTRO_FEATURES_LIBC_STREAMS  = "libc-streams"

DISTRO_FEATURES_LIBC = "${DISTRO_FEATURES_LIBC_TINY} \
                        ${DISTRO_FEATURES_LIBC_MINIMAL} \
                        ${DISTRO_FEATURES_LIBC_REGEX} \
                        ${DISTRO_FEATURES_LIBC_NET} \
                        ${DISTRO_FEATURES_LIBC_CRYPT} \
                        ${DISTRO_FEATURES_LIBC_BACKTRACE} \
                        ${DISTRO_FEATURES_LIBC_CVT} \
                        ${DISTRO_FEATURES_LIBC_I18N} \
                        ${DISTRO_FEATURES_LIBC_STREAMS} \
                       "



DISTRO_FEATURES = "acl ipv4 ipv6 largefile xattr pam ${DISTRO_FEATURES_LIBC}"
DISTRO_FEATURES_BACKFILL_CONSIDERED += "pulseaudio"
DISTRO_FEATURES_BACKFILL_CONSIDERED += "alsa"

PREFERRED_PROVIDER_jpeg ?= "jpeg"

VIRTUAL-RUNTIME_dev_manager = ""
VIRTUAL-RUNTIME_login_manager = ""
VIRTUAL-RUNTIME_init_manager = ""
VIRTUAL-RUNTIME_initscripts = ""
VIRTUAL-RUNTIME_keymaps = "" 

IMAGE_FSTYPES = "container tar"

# Drop v86d from qemu dependency list (we support serial)
# Drop grub from meta-intel BSPs
# FIXME: A different mechanism is needed here. We could define -tiny
#        variants of all compatible machines, but that leads to a lot
#        more machine configs to maintain long term.
MACHINE_ESSENTIAL_EXTRA_RDEPENDS = ""

# The mtrace script included by eglibc is a perl script. This means the system
# will build perl in case this package is installed. Since we don't care about
# this script for the purposes of tiny, remove the dependency from here.
RDEPENDS_${PN}-mtrace_pn-glibc = ""

ERROR_QA = "dev-so debug-deps dev-deps debug-files arch pkgconfig la perms \
            useless-rpaths rpaths staticdev ldflags pkgvarcheck already-stripped \
            compile-host-path dep-cmp install-host-path \
            packages-list perm-config perm-line perm-link pkgv-undefined \
            pn-overrides split-strip var-undefined version-going-backwards"

WARN_QA += " installed-vs-shipped"
```

## meta-securepoint/conf/layer.conf
```bitbake
# We have a conf and classes directory, add to BBPATH
BBPATH .= ":${LAYERDIR}"

# We have recipes-* directories, add to BBFILES
BBFILES += "${LAYERDIR}/recipes-*/*/*.bb \
	${LAYERDIR}/recipes-*/*/*.bbappend"

BBFILE_COLLECTIONS += "securepoint"
BBFILE_PATTERN_securepoint = "^${LAYERDIR}/"
BBFILE_PRIORITY_securepoint = "7"
LICENSE_PATH += "${LAYERDIR}/licenses"
LAYERSERIES_COMPAT_securepoint = "warrior honister kirkstone"

FILESYSTEM_PERMS_TABLES = "files/fs-perms.txt conf/sp-fs-perms.txt"

GIT_HOSTNAME = "development.intern.securepoint.de"
GIT_PROTO = "https"

PREFERRED_PROVIDER_zlib ?= "zlib"
PREFERRED_PROVIDER_zlib-native ?= "zlib-native"
```

## meta-securepoint/conf/machine/spx86-64.conf
```bitbake
MACHINE_FEATURES += "pcbios screen keyboard pci usbhost ext2 ext3 x86 acpi serial efi"
MACHINE_EXTRA_RRECOMMENDS += "kernel-modules"

DEFAULTTUNE ?= "core2-64"
require conf/machine/include/tune-core2.inc

PREFERRED_PROVIDER_virtual/kernel ?= "linux-yocto-sp"
PREFERRED_PROVIDER_login = "util-linux"

KERNEL_IMAGETYPE ?= "bzImage"

SERIAL_CONSOLE ?= "115200 ttyS0"

MACHINE_EXTRA_RRECOMMENDS += "v86d"

GLIBC_ADDONS = "nptl"
```

## meta-securepoint/conf/machine/spx86.conf
```bitbake
include conf/machine/include/tune-i586.inc
include conf/machine/include/ia32-base.inc
MACHINE_FEATURES += "pcbios screen pci usbhost ext2 ext3 x86 acpi serial"
MACHINE_EXTRA_RRECOMMENDS += "kernel-modules"

#IMAGE_FSTYPES += "ext3 cpio.gz live"

PREFERRED_PROVIDER_virtual/kernel ?= "linux-yocto-sp"
PREFERRED_PROVIDER_login = "util-linux"

KERNEL_IMAGETYPE ?= "bzImage"

SERIAL_CONSOLE ?= "115200 ttyS0"

MACHINE_EXTRA_RRECOMMENDS += "v86d"

GLIBC_ADDONS = "nptl"
```
